## components/audio_manager/Kconfig
```kconfig
menu "PEBL Audio"

    config AUDIO_ENABLED
        bool "Enable startup sound (MAX98357A I2S DAC)"
        default y if IDF_TARGET_ESP32S3
        default n
        help
            Play a short chime on boot via the MAX98357A I2S DAC.
            Only available on the custom PCB v1.1 (ESP32-S3) which has
            MAX98357A on GPIO38/39/40 with SD_MODE on GPIO21.

    config AUDIO_I2S_DOUT
        int "I2S data out GPIO (DIN on MAX98357A)"
        depends on AUDIO_ENABLED
        default 38

    config AUDIO_I2S_BCLK
        int "I2S bit clock GPIO (BCLK on MAX98357A)"
        depends on AUDIO_ENABLED
        default 39

    config AUDIO_I2S_LRCLK
        int "I2S word select GPIO (LRCLK on MAX98357A)"
        depends on AUDIO_ENABLED
        default 40

    config AUDIO_SD_MODE_GPIO
        int "DAC shutdown/enable GPIO (SD_MODE on MAX98357A)"
        depends on AUDIO_ENABLED
        default 21
        help
            HIGH = DAC enabled, LOW = DAC shutdown (saves ~2mA).
            Kept LOW except during active playback.

endmenu
```

## components/board/Kconfig
```kconfig
menu "Board Configuration"

    config BOARD_BUTTON_GPIO
        int "Button GPIO number"
        default 39 if IDF_TARGET_ESP32
        default 0 if IDF_TARGET_ESP32S3
        help
            GPIO pin connected to the physical button.
            LilyGo T5: GPIO 39 (built-in button).
            Custom S3 PCB: TBD per schematic.

    config BOARD_ADC_BATTERY_CHANNEL
        int "Battery ADC channel"
        default 0
        help
            ADC1 channel number for battery voltage divider.
            LilyGo T5: Channel 0 (GPIO 36).
            Custom S3 PCB: TBD per schematic.

    config BOARD_WAKE_USE_EXT0
        bool "Use ext0 wake source (ESP32 only)"
        default y if IDF_TARGET_ESP32
        default n if IDF_TARGET_ESP32S3
        help
            ESP32 supports ext0 (single GPIO, level-triggered) wake from deep sleep.
            ESP32-S3 does not have ext0 — use ext1 (bitmask, multiple GPIOs) instead.

endmenu
```

## components/display_manager/Kconfig
```kconfig
menu "PEBL Display"

    comment "SPI GPIO pins are configured in CalEPD's 'Display Configuration' menu"

    choice DISPLAY_VARIANT
        prompt "E-paper display variant"
        default DISPLAY_GDEW0213I5F
        help
            Select the e-paper display model for your hardware.
            This determines which CalEPD driver class is compiled in.
            Equivalent to PlatformIO build environments in the Arduino client.

        config DISPLAY_DEPG0213BN
            bool "2.13\" BW (DEPG0213BN / SSD1680) - LilyGo T5 V2.3.1 default"
            help
                DEPG0213BN 2.13" black/white display with SSD1680 controller.
                Arduino equivalent: env:lilygo_t5_depg_bw

        config DISPLAY_GDEW0213I5F
            bool "2.13\" 4G (GDEW0213I5F flex) - 4-level grayscale"
            help
                GDEW0213I5F 2.13" flexible display with 4-level grayscale support.
                Arduino equivalent: env:lilygo_t5_gdew_4g

        config DISPLAY_GDEY0213B74
            bool "2.13\" 4G (GDEY0213B74) - 4-level grayscale, fast refresh"
            help
                GDEY0213B74 2.13" display with 4-level grayscale and fast refresh.
                Arduino equivalent: env:lilygo_t5_gdey_4g

    endchoice

    config DISPLAY_WIDTH
        int
        default 212

    config DISPLAY_HEIGHT
        int
        default 104

endmenu
```

## components/led_manager/Kconfig
```kconfig
menu "PEBL LED Notification"

    config LED_ENABLED
        bool "Enable WS2812B notification LED"
        default y if IDF_TARGET_ESP32S3
        default n
        help
            Enable the WS2812B addressable RGB LED for reaction notifications.
            Only available on the custom PCB v1.1 (ESP32-S3) which has a
            WS2812B-2020 on GPIO18 via BSS138 level shifter.

    config LED_GPIO
        int "LED data GPIO"
        depends on LED_ENABLED
        default 18
        help
            GPIO connected to the WS2812B data input (via Q3 BSS138).

    config LED_BRIGHTNESS
        int "LED brightness (1-255)"
        depends on LED_ENABLED
        range 1 255
        default 20
        help
            Maximum brightness scaling factor. Keep low for battery life.
            WS2812B draws ~1mA per color channel at low brightness,
            up to ~60mA at full white (255).

    config LED_TIMEOUT_MINUTES
        int "Auto-off timeout (minutes)"
        depends on LED_ENABLED
        range 1 60
        default 15
        help
            LED turns off automatically after this many minutes.
            Each new notification resets the timer.

endmenu
```
